## CMakeLists.txt
```
# SPDX-License-Identifier: Apache-2.0
#
# PiZZa -- SDLPoP (Prince of Persia) via minimal SDL2 shim.
#
# Stand-alone Zephyr application linking the NagyD/SDLPoP game
# sources (pure C, UNTOUCHED -- the tree at ~/github/SDLPoP is never
# edited) against a purpose-built SDL2 shim (include/SDL2 +
# src/shim_*.c) that lands on the proven Jet/wipeout framebuffer
# present path (bcm2835_fb + HVS 320x200 -> panel scaling).
#
# SDLPoP is GPL-3.0-or-later; this binary is GPL-3.0 by virtue of
# linking it. The shim + port files themselves are Apache-2.0, same
# model as the wipeout demo (AGPL engine, Apache port glue).
#
# Asset pipeline decision (work-order §4, made in phase 1):
#   PREFERRED  build-time conversion -- res###.png -> raw indexed
#              blobs packed into an embedded asset image linked into
#              the app; IMG_Load_RW parses the raw header instead of
#              PNG; no SDL2_image, no FS on the critical path.
#   FALLBACK   SD + FAT (proven on PiZZa) if asset iteration without
#              reflashing matters during bring-up.
# The repo's data/ tree ships the main graphics ONLY as loose
# res###.png directory resources (no DAT archives), so every image
# goes through IMG_Load_RW -- the §4 converter is load-bearing.

cmake_minimum_required(VERSION 3.20.0)

find_package(Zephyr REQUIRED HINTS $ENV{ZEPHYR_BASE})
project(pizza-sdlpop C)

# sample_usbd helper for the USB CDC ACM shell, same as PizzaShell /
# Jet / wipeout.
if(CONFIG_USB_DEVICE_STACK_NEXT)
  include(${ZEPHYR_BASE}/samples/subsys/usb/common/common.cmake)
endif()

if(NOT DEFINED POP_SRC_DIR)
  set(POP_SRC_DIR "$ENV{HOME}/github/SDLPoP/src")
endif()
if(NOT EXISTS "${POP_SRC_DIR}/seg000.c")
  message(FATAL_ERROR
    "SDLPoP sources not found at ${POP_SRC_DIR}. Clone "
    "https://github.com/NagyD/SDLPoP and either keep it at "
    "~/github/SDLPoP or pass -DPOP_SRC_DIR=<path>.")
endif()

# Upstream game sources, complete and unmodified (list mirrors the
# upstream CMakeLists). opl3/stb_vorbis are the in-tree audio
# generators -- they compile everywhere and stay silent behind the
# stubbed audio backend.
set(POP_GAME_SRC
  ${POP_SRC_DIR}/main.c
  ${POP_SRC_DIR}/data.c
  ${POP_SRC_DIR}/lighting.c
  ${POP_SRC_DIR}/menu.c
  ${POP_SRC_DIR}/midi.c
  ${POP_SRC_DIR}/opl3.c
  ${POP_SRC_DIR}/options.c
  ${POP_SRC_DIR}/replay.c
  ${POP_SRC_DIR}/screenshot.c
  ${POP_SRC_DIR}/seg000.c
  ${POP_SRC_DIR}/seg001.c
  ${POP_SRC_DIR}/seg002.c
  ${POP_SRC_DIR}/seg003.c
  ${POP_SRC_DIR}/seg004.c
  ${POP_SRC_DIR}/seg005.c
  ${POP_SRC_DIR}/seg006.c
  ${POP_SRC_DIR}/seg007.c
  ${POP_SRC_DIR}/seg008.c
  ${POP_SRC_DIR}/seg009.c
  ${POP_SRC_DIR}/seqtbl.c
  ${POP_SRC_DIR}/stb_vorbis.c
)

# The shim: one concern per file (work-order §1).
set(POP_SHIM_SRC
  src/shim_main.c
  src/shim_core.c
  src/shim_video.c
  src/shim_surface.c
  src/shim_event.c
  src/shim_timer.c
  src/shim_rw.c
  src/shim_image.c
  src/shim_stub.c
  src/shim_posix.c
)

if(CONFIG_SDLPOP_AUDIO_NONE)
  list(APPEND POP_SHIM_SRC src/shim_audio_none.c)
elseif(CONFIG_SDLPOP_AUDIO_HDMI)
  # HDMI-audio work order §2: freestanding core (host-tested by
  # tests/audio_host) + MAI hardware programming + Zephyr glue.
  list(APPEND POP_SHIM_SRC
    src/shim_audio_hdmi.c
    src/audio/iec958_pack.c
    src/audio/resample_48k.c
    src/audio/ring.c
    src/audio/audio_pump.c
    src/audio/hdmi_audio_init.c
  )
endif()

# `pop` shell command set -- interactive key injection over the USB
# CDC ACM line (the input path on hardware until HOGP keyboard lands).
if(CONFIG_SHELL)
  list(APPEND POP_SHIM_SRC src/shim_shell.c)
endif()

# USB device stack bring-up (CDC ACM shell endpoint). Required because
# the board conf defers CDC auto-init; without this the port never
# enumerates on the host.
if(CONFIG_USB_DEVICE_STACK_NEXT)
  list(APPEND POP_SHIM_SRC src/shim_usb.c)
endif()

if(CONFIG_SDLPOP_PRESENT_DISPLAY)
  list(APPEND POP_SHIM_SRC src/pop_present_display.c)
elseif(CONFIG_SDLPOP_PRESENT_SEMIHOST)
  list(APPEND POP_SHIM_SRC src/pop_present_semihost.c)
else()
  list(APPEND POP_SHIM_SRC src/pop_present_none.c)
endif()

if(CONFIG_SDLPOP_VIDEO_SELFTEST)
  list(APPEND POP_SHIM_SRC src/shim_selftest.c)
endif()

if(CONFIG_SDLPOP_SCRIPTED_INPUT)
  list(APPEND POP_SHIM_SRC src/shim_scripted.c)
endif()

# Embedded asset pack (§4 preferred pipeline): pack_assets.py
# pre-converts every PNG to a raw PIMG blob and packs the data/ tree
# (music excluded) into one binary, linked via .incbin.
if(NOT DEFINED POP_DATA_DIR)
  get_filename_component(POP_DATA_DIR "${POP_SRC_DIR}/../data" ABSOLUTE)
endif()
set(POP_PACK_BIN ${CMAKE_BINARY_DIR}/sdlpop_assets.bin)
file(GLOB_RECURSE POP_DATA_FILES ${POP_DATA_DIR}/*)
set(POP_PACK_OVERLAY_ARGS "")
set(POP_PACK_OVERLAY_DEPS "")
if(CONFIG_SDLPOP_SIM_TUNING)
  # Sim-only: pack the tuning ini at pack root (hardware ships none).
  file(GLOB_RECURSE POP_OVERLAY_FILES ${CMAKE_CURRENT_SOURCE_DIR}/sim_overlay/*)
  set(POP_PACK_OVERLAY_ARGS --overlay ${CMAKE_CURRENT_SOURCE_DIR}/sim_overlay)
  set(POP_PACK_OVERLAY_DEPS ${POP_OVERLAY_FILES})
endif()
add_custom_command(
  OUTPUT ${POP_PACK_BIN}
  COMMAND ${Python3_EXECUTABLE} ${CMAKE_CURRENT_SOURCE_DIR}/tools/pack_assets.py
          ${POP_DATA_DIR} ${POP_PACK_BIN} ${POP_PACK_OVERLAY_ARGS}
  DEPENDS ${POP_DATA_FILES} ${POP_PACK_OVERLAY_DEPS}
          ${CMAKE_CURRENT_SOURCE_DIR}/tools/pack_assets.py
  COMMENT "Packing SDLPoP assets (PNG -> PIMG)"
)
add_custom_target(pop_assets_pack DEPENDS ${POP_PACK_BIN})
add_dependencies(app pop_assets_pack)

list(APPEND POP_SHIM_SRC src/pop_assets.c src/pop_pack.S)
set_source_files_properties(src/pop_pack.S PROPERTIES
  OBJECT_DEPENDS ${POP_PACK_BIN}
  COMPILE_OPTIONS "-I${CMAKE_BINARY_DIR};-Wa,-I${CMAKE_BINARY_DIR}"
)

target_sources(app PRIVATE
  ${POP_GAME_SRC}
  ${POP_SHIM_SRC}
)

# include/ first so <SDL2/SDL.h> resolves to the shim headers.
target_include_directories(app PRIVATE
  include
  ${POP_SRC_DIR}
  src
)

# The game trips pedantic warnings upstream builds silence too.
# -include: SDLPoP assumes glibc, where <string.h>/<stdlib.h> pull in
# strcasecmp and alloca; picolibc keeps them in <strings.h>/<alloca.h>.
# -Didle=...: SDLPoP's global idle() collides with the Zephyr kernel
# idle-thread entry symbol -- the link silently resolved the kernel's
# idle thread to the GAME's event loop (crashed on first k_msleep).
# Rename in game TUs only, same trick as SDL's main=SDL_main.
set_source_files_properties(${POP_GAME_SRC} PROPERTIES COMPILE_OPTIONS
  "-Wno-unused-variable;-Wno-unused-but-set-variable;-Wno-missing-braces;-Wno-unused-function;-Wno-maybe-uninitialized;-include;strings.h;-include;alloca.h;-D_DEFAULT_SOURCE;-Didle=pop_game_idle"
)
```

## Kconfig
```
# SPDX-License-Identifier: Apache-2.0
#
# PiZZa SDLPoP port -- app options. The backend choices are the §5
# seams: stubs today, real backends drop in via these switches with
# no game or shim changes.

# SAMPLE_USBD_* options for sample_usbd_init.c on boards with the USB
# device stack. Same pattern PizzaShell / Jet / wipeout use.
source "samples/subsys/usb/common/Kconfig.sample_usbd"

menu "PiZZa SDLPoP port"

choice SDLPOP_PRESENT_BACKEND
	prompt "Frame present backend"
	default SDLPOP_PRESENT_DISPLAY if DISPLAY
	default SDLPOP_PRESENT_NONE

config SDLPOP_PRESENT_DISPLAY
	bool "Zephyr display API (bcm2835_fb + HVS scaling on hardware)"
	depends on DISPLAY

config SDLPOP_PRESENT_NONE
	bool "Drop frames (link/sim bring-up)"

config SDLPOP_PRESENT_SEMIHOST
	bool "Semihosting PPM capture (qemu sim gates)"
	depends on SEMIHOST

endchoice

config SDLPOP_CAPTURE_EVERY
	int "Capture every Nth presented frame (0 = first frame only)"
	depends on SDLPOP_PRESENT_SEMIHOST
	default 0

config SDLPOP_VIDEO_SELFTEST
	bool "Present color bars through the shim video path before the game starts"
	default n

config SDLPOP_SELFTEST_HOLD_MS
	int "How long to hold the selftest color bars on the panel (ms)"
	depends on SDLPOP_VIDEO_SELFTEST
	default 5000
	help
	  On hardware this is the window to eyeball the present path and R/B
	  channel order. Set 0-ish once signed off, or disable the selftest.

config SDLPOP_SCRIPTED_INPUT
	bool "Drive the game from a scripted synthetic input source (§5b seam)"
	default n

config SDLPOP_SIM_TUNING
	bool "Pack the sim-only tuning ini (fades off) to reach gameplay fast under TCG"
	default n

config SDLPOP_SKIP_INFO_SCREEN
	bool "Skip the SDLPoP info/splash screen (boot straight to the original intro)"
	default y
	help
	  SDLPoP inserts its own "SDLPoP <version> ... Press any key to
	  continue" info screen (seg000.c show_splash) before the game's
	  original title sequence. This port has no user-editable
	  SDLPoP.ini to act on and no keyboard at boot, so that screen
	  only blocks the original Broderbund/title intro and its theme.
	  Packing a one-line SDLPoP.ini with enable_info_screen = false
	  into the asset pack disables it -- boot goes straight to the
	  original splash/intro. The sim build (SDLPOP_SIM_TUNING) already
	  bypasses show_splash via its start-level arg, so this option is
	  ignored there.

choice SDLPOP_AUDIO_BACKEND
	prompt "Audio backend (work-order §5a seam)"
	default SDLPOP_AUDIO_NONE

config SDLPOP_AUDIO_NONE
	bool "None -- SDL_OpenAudio fails, game disables audio"

config SDLPOP_AUDIO_HDMI
	bool "HDMI audio via VC4 MAI (48 kHz stereo IEC958, BCM2835 DMA)"
	depends on DMA_BCM2835 && BCM2835_FB
	help
	  Real §5a backend (HDMI-audio work order): the game's 44.1 kHz
	  callback mix is resampled to 48 kHz, packed into IEC958
	  subframes and DMA-fed (DREQ-paced) into the VC4 MAI FIFO on
	  the HDMI output the firmware already drives for video.
	  Requires hdmi_drive=2 in config.txt and a display that
	  accepts audio (a TV, not a DVI monitor).

endchoice

config SDLPOP_AUDIO_HDMI_TEST_TONE
	bool "Boot into the M2 1 kHz test tone instead of game audio"
	depends on SDLPOP_AUDIO_HDMI
	default n
	help
	  Hardware sign-off diagnostic (work order M2): at boot the
	  backend opens with a synthetic 1 kHz -12 dBFS source through
	  the full resample/pack/DMA/MAI path and plays it forever.
	  The game still runs, but its own SDL_OpenAudio fails while
	  the tone owns the path. Check status with `pop audio`.

module = SDLPOP
module-str = sdlpop
source "subsys/logging/Kconfig.template.log_config"

endmenu

source "Kconfig.zephyr"
```

## prj.conf
```kconfig
# SPDX-License-Identifier: Apache-2.0
#
# Common config for the PiZZa SDLPoP port. Per-board overrides
# (display, USB, SD) live in boards/<board>.conf.

CONFIG_PRINTK=y
CONFIG_BOOT_BANNER=y

# Keep printk() synchronous so the game's boot-time logging lands on
# the console even when the render loop is busy (Jet/wipeout pattern).
CONFIG_LOG_PRINTK=n

# picolibc's errno needs TLS -- same hard-won stanza as the wipeout
# port; without it the first failing fs/stdio call scribbles through
# a wild TPIDRRO_EL0 offset.
CONFIG_TOOLCHAIN_CROSS_COMPILE_SUPPORTS_THREAD_LOCAL_STORAGE=y
CONFIG_THREAD_LOCAL_STORAGE=y

# Heap: SDLPoP mallocs every decoded sprite surface (~4 MB of PNGs
# expand to indexed surfaces), the onscreen/overlay surfaces, texture
# buffers and the odd qsort scratch. 16 MiB gives generous headroom
# on both the 512 MiB board and qemu.
CONFIG_COMMON_LIBC_MALLOC_ARENA_SIZE=16777216

# The game runs on the Zephyr main thread; init/menu call chains run
# deep.
CONFIG_MAIN_STACK_SIZE=65536

CONFIG_FPU=y
CONFIG_STACK_SENTINEL=y
CONFIG_ASSERT=y
```

## boards/qemu_cortex_a53.conf
```kconfig
# SPDX-License-Identifier: Apache-2.0
#
# qemu_cortex_a53 -- the SIM target for the work-order's sim-verified
# gates. No display hardware: frames leave the guest as PPM files via
# semihosting (pop_present_semihost.c); qemu gets the semihosting
# flags automatically from cmake/emu/qemu.cmake when CONFIG_SEMIHOST.

# Run the emulated CPU at wall speed. The default -icount shift=4
# stretches this software-rendered, per-pixel-blit workload ~40x in
# wall-clock; the game's own k_timer pacing keeps frame timing sane
# without it, and disabling lets the sim actually reach gameplay.
CONFIG_QEMU_ICOUNT=n

CONFIG_SEMIHOST=y
CONFIG_SDLPOP_PRESENT_SEMIHOST=y
CONFIG_SDLPOP_CAPTURE_EVERY=25
CONFIG_SDLPOP_VIDEO_SELFTEST=y
CONFIG_SDLPOP_SCRIPTED_INPUT=y
CONFIG_SDLPOP_SIM_TUNING=y

# Synchronous shim logging on the emulated console.
CONFIG_LOG=y
CONFIG_LOG_MODE_MINIMAL=y
CONFIG_SDLPOP_LOG_LEVEL_DBG=y
```

## boards/rpi_zero_2w.conf
```kconfig
# SPDX-License-Identifier: Apache-2.0
#
# Raspberry Pi Zero 2 W (BCM2710, Cortex-A53, AArch64) -- SDLPoP.
# Single-core (the game is single-threaded DOS logic; no SMP).
# Console + logs on the mini-UART, interactive shell on USB CDC ACM,
# HDMI via the VC firmware framebuffer with HVS 320x200 scaling.

CONFIG_BOOT_DELAY=200

# VC mailbox + firmware (framebuffer alloc chain).
CONFIG_RASPBERRYPI_FIRMWARE=y

# HDMI display via VC firmware FB, ARGB_8888. The shim paints the
# game's 320x200 frame into the virtual FB; HVS scales to the
# monitor's native mode.
CONFIG_DISPLAY=y
CONFIG_BCM2835_FB=y

# BCM2835 DMA -- FB driver claims a channel for the backbuffer blit;
# the HDMI audio backend claims a second (cyclic, DREQ 17 -> MAI).
CONFIG_DMA=y
CONFIG_DMA_BCM2835=y

# HDMI audio (work order): 8-block IEC958 ring needs 8 control blocks
# on the audio channel.
CONFIG_SDLPOP_AUDIO_HDMI=y
CONFIG_DMA_BCM2835_MAX_CBS_PER_CHANNEL=8

# USB CDC ACM shell, same shape as PizzaShell/wipeout. The `pop`
# command set (frame capture, scripted input) registers here.
CONFIG_USB_DEVICE_STACK_NEXT=y
CONFIG_UDC_DWC2=y
CONFIG_UDC_DWC2_DMA=n
CONFIG_SERIAL=y
CONFIG_USBD_CDC_ACM_CLASS=y
CONFIG_CDC_ACM_SERIAL_INITIALIZE_AT_BOOT=n
CONFIG_SAMPLE_USBD_PRODUCT="PiZZa SDLPoP -- rpi_zero_2w"
CONFIG_SAMPLE_USBD_MANUFACTURER="jetpax/PiZZa"
CONFIG_SAMPLE_USBD_PID=0xCAFE
CONFIG_USBD_THREAD_STACK_SIZE=4096
CONFIG_UDC_DWC2_STACK_SIZE=4096

CONFIG_SHELL=y
CONFIG_SHELL_BACKEND_SERIAL=y
CONFIG_KERNEL_SHELL=y
CONFIG_SHELL_STACK_SIZE=8192
CONFIG_SHELL_VT100_COMMANDS=y
CONFIG_SHELL_HISTORY=y
CONFIG_SHELL_TAB=y
CONFIG_SHELL_LOG_BACKEND=n

# Logging on the board console (mini-UART), off the shell prompt.
CONFIG_LOG=y
CONFIG_LOG_BUFFER_SIZE=16384
CONFIG_LOG_BACKEND_UART=y
CONFIG_LOG_MODE_DEFERRED=y
CONFIG_USBD_CDC_ACM_LOG_LEVEL_WRN=y
CONFIG_USBD_LOG_LEVEL_INF=y
CONFIG_UDC_DRIVER_LOG_LEVEL_WRN=y
```

## src/pop_assets.c
```c
/*
 * SPDX-License-Identifier: Apache-2.0
 *
 * PiZZa SDLPoP port -- embedded asset store (work-order §4).
 *
 * The pack built by tools/pack_assets.py is linked into .rodata; this
 * file implements the read-only POSIX fd layer over it. picolibc's
 * tinystdio (fopen/fread/fseek/fileno) funnels through open/read/
 * lseek/close, so the whole game "filesystem" resolves here with the
 * game tree untouched and no FS driver on the critical path.
 *
 * Path normalization: the game asks for CWD-relative paths
 * ("data/KID/res401.png") when access() says they exist -- which it
 * does here -- but may also try exe-dir-prefixed variants
 * ("prince/data/..."); the resolver retries from the first "data/"
 * component.
 *
 * Writes (quicksave, replays, screenshots) fail with EROFS -- the
 * game reports and continues. Backing saves with Zephyr fs_* on the
 * SD card is a later, additive step.
 */

#include <zephyr/kernel.h>
#include <zephyr/sys/printk.h>
#include <errno.h>
#include <fcntl.h>
#include <stdlib.h>
#include <string.h>
#include <sys/stat.h>
#include <sys/types.h>
#include <unistd.h>

struct pack_entry {
	uint32_t path_off;
	uint32_t data_off;
	uint32_t size;
} __packed;

extern const uint8_t pop_pack_start[];
extern const uint8_t pop_pack_end[];

static const struct pack_entry *pack_entries;
static uint32_t pack_count;
static bool pack_ready;

#define POP_FD_BASE 3
#define POP_FD_MAX  16

static struct {
	const struct pack_entry *entry;
	size_t pos;
	bool used;
} fds[POP_FD_MAX];

static void pack_init(void)
{
	if (pack_ready) {
		return;
	}
	if (memcmp(pop_pack_start, "POPPACK1", 8) != 0) {
		printk("[sdlpop] asset pack magic mismatch!\n");
		pack_count = 0;
	} else {
		pack_count = *(const uint32_t *)(pop_pack_start + 8);
		pack_entries = (const struct pack_entry *)(pop_pack_start + 12);
		printk("[sdlpop] asset pack: %u entries, %u bytes\n",
		       pack_count, (uint32_t)(pop_pack_end - pop_pack_start));
	}
	pack_ready = true;
}

static const char *entry_path(const struct pack_entry *e)
{
	return (const char *)pop_pack_start + e->path_off;
}

static const struct pack_entry *pack_lookup_exact(const char *path)
{
	uint32_t lo = 0, hi = pack_count;

	while (lo < hi) {
		uint32_t mid = (lo + hi) / 2;
		int c = strcmp(entry_path(&pack_entries[mid]), path);

		if (c == 0) {
			return &pack_entries[mid];
		}
		if (c < 0) {
			lo = mid + 1;
		} else {
			hi = mid;
		}
	}
	return NULL;
}

static const char *normalize(const char *path, char *buf, size_t buflen)
{
	strncpy(buf, path, buflen - 1);
	buf[buflen - 1] = '\0';

	const char *p = buf;

	while (p[0] == '.' && p[1] == '/') {
		p += 2;
	}
	while (p[0] == '/') {
		p++;
	}
	return p;
}

static const struct pack_entry *pack_lookup(const char *path)
{
	pack_init();
	if (path == NULL || pack_count == 0) {
		return NULL;
	}

	char norm[256];
	const char *p = normalize(path, norm, sizeof(norm));
	const struct pack_entry *e = pack_lookup_exact(p);

	if (e != NULL) {
		return e;
	}

	/* exe-dir-prefixed variants: retry from the first "data/" */
	const char *d = strstr(p, "data/");

	if (d != NULL && d != p) {
		return pack_lookup_exact(d);
	}
	return NULL;
}

/* Directory probe: true when any entry lives under path/ (the game
 * stats data/KID etc. to decide the loose-resource layout exists).
 */
static bool pack_lookup_dir_exact(const char *path)
{
	size_t len = strlen(path);

	if (len == 0) {
		return false;
	}

	uint32_t lo = 0, hi = pack_count;

	while (lo < hi) {
		uint32_t mid = (lo + hi) / 2;

		if (strcmp(entry_path(&pack_entries[mid]), path) < 0) {
			lo = mid + 1;
		} else {
			hi = mid;
		}
	}
	if (lo == pack_count) {
		return false;
	}

	const char *cand = entry_path(&pack_entries[lo]);

	return strncmp(cand, path, len) == 0 && cand[len] == '/';
}

static bool pack_lookup_dir(const char *path)
{
	pack_init();
	if (path == NULL || pack_count == 0) {
		return false;
	}

	char norm[256];
	const char *p = normalize(path, norm, sizeof(norm));

	if (pack_lookup_dir_exact(p)) {
		return true;
	}

	const char *d = strstr(p, "data/");

	return (d != NULL && d != p) ? pack_lookup_dir_exact(d) : false;
}

/* ── POSIX fd layer (picolibc tinystdio backend) ─────────────── */

int open(const char *path, int flags, ...)
{
	if ((flags & O_ACCMODE) != O_RDONLY) {
		errno = EROFS;
		return -1;
	}

	const struct pack_entry *e = pack_lookup(path);

	if (e == NULL) {
		errno = ENOENT;
		return -1;
	}

	for (int i = 0; i < POP_FD_MAX; i++) {
		if (!fds[i].used) {
			fds[i].entry = e;
			fds[i].pos = 0;
			fds[i].used = true;
			return POP_FD_BASE + i;
		}
	}
	errno = EMFILE;
	return -1;
}

static int fd_slot(int fd)
{
	int i = fd - POP_FD_BASE;

	if (i < 0 || i >= POP_FD_MAX || !fds[i].used) {
		return -1;
	}
	return i;
}

int close(int fd)
{
	int i = fd_slot(fd);

	if (i < 0) {
		errno = EBADF;
		return -1;
	}
	fds[i].used = false;
	return 0;
}

ssize_t read(int fd, void *buf, size_t count)
{
	int i = fd_slot(fd);

	if (i < 0) {
		errno = EBADF;
		return -1;
	}

	const struct pack_entry *e = fds[i].entry;
	size_t avail = e->size - fds[i].pos;
	size_t n = MIN(count, avail);

	memcpy(buf, pop_pack_start + e->data_off + fds[i].pos, n);
	fds[i].pos += n;
	return (ssize_t)n;
}

ssize_t write(int fd, const void *buf, size_t count)
{
	ARG_UNUSED(buf);
	ARG_UNUSED(count);
	errno = (fd_slot(fd) < 0) ? EBADF : EROFS;
	return -1;
}

off_t lseek(int fd, off_t offset, int whence)
{
	int i = fd_slot(fd);

	if (i < 0) {
		errno = EBADF;
		return (off_t)-1;
	}

	const struct pack_entry *e = fds[i].entry;
	off_t base;

	switch (whence) {
	case SEEK_SET:
		base = 0;
		break;
	case SEEK_CUR:
		base = (off_t)fds[i].pos;
		break;
	case SEEK_END:
		base = (off_t)e->size;
		break;
	default:
		errno = EINVAL;
		return (off_t)-1;
	}

	off_t target = base + offset;

	if (target < 0 || target > (off_t)e->size) {
		errno = EINVAL;
		return (off_t)-1;
	}
	fds[i].pos = (size_t)target;
	return target;
}

int fstat(int fd, struct stat *st)
{
	int i = fd_slot(fd);

	if (i < 0) {
		errno = EBADF;
		return -1;
	}
	memset(st, 0, sizeof(*st));
	st->st_size = (off_t)fds[i].entry->size;
	st->st_mode = S_IFREG | 0444;
	return 0;
}

int stat(const char *path, struct stat *st)
{
	const struct pack_entry *e = pack_lookup(path);

	if (e != NULL) {
		memset(st, 0, sizeof(*st));
		st->st_size = (off_t)e->size;
		st->st_mode = S_IFREG | 0444;
		return 0;
	}
	if (pack_lookup_dir(path)) {
		memset(st, 0, sizeof(*st));
		st->st_mode = S_IFDIR | 0555;
		return 0;
	}
	errno = ENOENT;
	return -1;
}

int access(const char *path, int mode)
{
	if (pack_lookup(path) == NULL && !pack_lookup_dir(path)) {
		errno = ENOENT;
		return -1;
	}
	if ((mode & W_OK) != 0) {
		errno = EROFS;
		return -1;
	}
	return 0;
}

/* Direct lookup for shim-internal users (IMG_Load). */
const void *pop_asset_find(const char *path, size_t *size)
{
	const struct pack_entry *e = pack_lookup(path);

	if (e == NULL) {
		return NULL;
	}
	if (size != NULL) {
		*size = e->size;
	}
	return pop_pack_start + e->data_off;
}
```

## src/pop_present_display.c
```c
/*
 * SPDX-License-Identifier: Apache-2.0
 *
 * PiZZa SDL2 shim -- display present backend
 * (CONFIG_SDLPOP_PRESENT_DISPLAY).
 *
 * Pushes the game's composed 320x200 RGB24 frame at the Zephyr
 * display API. On rpi_zero_2w that is the bcm2835_fb driver with a
 * 320x200 virtual framebuffer: 320 * 4 = 1280 bytes/row is 64-byte
 * aligned so the driver's contiguous-DMA fast path engages, and the
 * VideoCore HVS scales to the monitor's native mode -- the same
 * proven path as the Jet and wipeout ports.
 *
 * Conversion: game memory bytes [R,G,B] (SDLPoP's LE 24bpp masks)
 * -> LE ARGB8888 words (A<<24 | R<<16 | G<<8 | B), matching what the
 * wipeout port established the VC scanout expects.
 */

#include <zephyr/kernel.h>
#include <zephyr/device.h>
#include <zephyr/drivers/display.h>
#include <zephyr/logging/log.h>

#include "pop_shim.h"

LOG_MODULE_REGISTER(pop_present, CONFIG_SDLPOP_LOG_LEVEL);

#define POP_W 320
#define POP_H 200

static const struct device *display_dev;
static uint32_t backbuf[POP_W * POP_H];
static bool ready;

int pop_present_init(int width, int height)
{
	if (width != POP_W || height != POP_H) {
		LOG_ERR("present: %dx%d requested, backend is fixed %dx%d",
			width, height, POP_W, POP_H);
		return -EINVAL;
	}

	display_dev = DEVICE_DT_GET(DT_CHOSEN(zephyr_display));
	if (!device_is_ready(display_dev)) {
		LOG_ERR("present: display device not ready -- HDMI not connected?");
		return -ENODEV;
	}

	struct display_capabilities caps;

	display_get_capabilities(display_dev, &caps);
	LOG_INF("present: display %ux%u (HVS virt) fmt=0x%x",
		caps.x_resolution, caps.y_resolution,
		(unsigned int)caps.current_pixel_format);

	if (caps.x_resolution != POP_W || caps.y_resolution != POP_H) {
		LOG_WRN("present: display reports %ux%u, expected %ux%u "
			"(check render-width/render-height in overlay)",
			caps.x_resolution, caps.y_resolution, POP_W, POP_H);
	}

	ready = true;
	return 0;
}

void pop_present_frame(const void *rgb24_pixels, int pitch)
{
	if (!ready) {
		return;
	}

	const uint8_t *src_row = rgb24_pixels;
	uint32_t *dst = backbuf;

	for (int y = 0; y < POP_H; y++) {
		const uint8_t *px = src_row;

		for (int x = 0; x < POP_W; x++) {
			*dst++ = 0xFF000000u |
				 ((uint32_t)px[0] << 16) |
				 ((uint32_t)px[1] << 8) |
				 (uint32_t)px[2];
			px += 3;
		}
		src_row += pitch;
	}

	struct display_buffer_descriptor desc = {
		.buf_size = sizeof(backbuf),
		.width = POP_W,
		.height = POP_H,
		.pitch = POP_W,
		.frame_incomplete = false,
	};

	/* Synchronous write: single backbuffer, same reasoning as the
	 * wipeout port (an async kick from frame N would race frame
	 * N+1's composition).
	 */
	int rc = display_write(display_dev, 0, 0, &desc, backbuf);

	if (rc != 0) {
		LOG_ERR("present: display_write rc=%d", rc);
	}
}
```

## src/pop_present_semihost.c
```c
/*
 * SPDX-License-Identifier: Apache-2.0
 *
 * PiZZa SDL2 shim -- semihosting capture present backend
 * (CONFIG_SDLPOP_PRESENT_SEMIHOST, qemu sim targets).
 *
 * Frames land on the host filesystem as binary PPM (P6) files --
 * the work-order's "fb PNG dump" gate, one `magick` away from PNG.
 * The game's RGB24 buffer is already [R,G,B] bytes, so the dump is
 * header + rows, no conversion.
 *
 * Frame 1 is always written; with CONFIG_SDLPOP_CAPTURE_EVERY=N > 0
 * every Nth frame is written too (phase-4 frame sequences).
 */

#include <zephyr/kernel.h>
#include <zephyr/arch/common/semihost.h>
#include <zephyr/logging/log.h>
#include <stdio.h>

#include "pop_shim.h"

LOG_MODULE_REGISTER(pop_present, CONFIG_SDLPOP_LOG_LEVEL);

static int fb_w;
static int fb_h;
static uint32_t frames;

int pop_present_init(int width, int height)
{
	fb_w = width;
	fb_h = height;
	LOG_INF("present: semihost capture backend (%dx%d)", width, height);
	return 0;
}

void pop_present_frame(const void *rgb24_pixels, int pitch)
{
	frames++;

	bool capture = (frames == 1);

	if (CONFIG_SDLPOP_CAPTURE_EVERY > 0 &&
	    (frames % CONFIG_SDLPOP_CAPTURE_EVERY) == 0) {
		capture = true;
	}
	if (!capture) {
		return;
	}

	char name[48];
	char header[32];

	snprintf(name, sizeof(name), "sdlpop_frame_%06u.ppm", frames);

	long fd = semihost_open(name, SEMIHOST_OPEN_WB);

	if (fd < 0) {
		LOG_ERR("present: semihost_open(%s) = %ld", name, fd);
		return;
	}

	int hlen = snprintf(header, sizeof(header), "P6\n%d %d\n255\n", fb_w, fb_h);

	semihost_write(fd, header, hlen);

	const uint8_t *row = rgb24_pixels;

	for (int y = 0; y < fb_h; y++) {
		semihost_write(fd, row, (long)fb_w * 3);
		row += pitch;
	}
	semihost_close(fd);
	LOG_INF("present: wrote %s", name);
}
```

## src/pop_shim.h
```c
/*
 * SPDX-License-Identifier: Apache-2.0
 *
 * PiZZa SDL2 shim -- internal interfaces between the shim_*.c files
 * and the platform seams (present path, audio backend, event
 * producers). Nothing in here is visible to SDLPoP.
 */

#ifndef PIZZA_POP_SHIM_H
#define PIZZA_POP_SHIM_H

#define SDL_MAIN_HANDLED
#include <SDL2/SDL.h>

#ifdef __cplusplus
extern "C" {
#endif

/* ── error (shim_core.c) ─────────────────────────────────────── */

void pop_set_error(const char *fmt, ...);

/* ── surface internals (shim_surface.c) ──────────────────────── */

/* Every SDL_Surface handed to the game is the first member of a
 * pop_surface, so shim code can downcast to reach blit state the
 * public struct doesn't carry.
 */
struct pop_surface {
	SDL_Surface s;          /* must stay first */
	SDL_PixelFormat fmt;
	SDL_Palette pal;
	SDL_Color colors[256];
	Uint32 colorkey;
	int has_colorkey;
	Uint8 alpha_mod;
	SDL_BlendMode blend;
};

#define POP_SURF(sdl_surface) ((struct pop_surface *)(sdl_surface))

/* ── event queue (shim_event.c) ──────────────────────────────── */

/* Producer seam: any source (scripted input, timer callbacks, HOGP
 * keyboard thread later) submits through here. ISR-safe.
 * KEYDOWN/KEYUP submissions also update the SDL_GetKeyboardState
 * array. Returns 0 on success, -1 if the queue is full.
 */
int pop_event_submit(const SDL_Event *event);

/* Scripted synthetic input source (CONFIG_SDLPOP_SCRIPTED_INPUT). */
void pop_scripted_input_start(void);

/* ── present seam (pop_present_*.c, Kconfig-selected) ────────── */

/* The video shim composes the final 320x200 frame and pushes it
 * through this seam. Backends: bcm2835_fb display path (hardware),
 * capture/none (sim). pixels is the game's RGB24 buffer, memory
 * byte order R,G,B (LE masks per SDLPoP types.h).
 */
int pop_present_init(int width, int height);
void pop_present_frame(const void *rgb24_pixels, int pitch);

/* Video-path self-test (CONFIG_SDLPOP_VIDEO_SELFTEST): color bars
 * through the full surface->texture->present path before the game
 * starts.
 */
void pop_video_selftest(void);

/* ── embedded asset store (pop_assets.c, work-order §4) ──────── */

/* Direct pack lookup for shim-internal users (IMG_Load, selftests).
 * Returns a pointer into the read-only pack, or NULL.
 */
const void *pop_asset_find(const char *path, size_t *size);

/* ── audio backend seam (§5a -- link-time function table) ────── */

/* SDL audio entry points in shim_stub.c delegate to these. The
 * backend is chosen by Kconfig at build time (no runtime vtable):
 * shim_audio_none.c today, shim_audio_i2s.c when §5a lands.
 */
int pop_audio_open(SDL_AudioSpec *desired, SDL_AudioSpec *obtained);
void pop_audio_close(void);
void pop_audio_pause(int pause_on);
void pop_audio_lock(void);
void pop_audio_unlock(void);
SDL_AudioStatus pop_audio_status(void);

#ifdef __cplusplus
}
#endif

#endif /* PIZZA_POP_SHIM_H */
```

## src/shim_audio_none.c
```c
/*
 * SPDX-License-Identifier: Apache-2.0
 *
 * PiZZa SDL2 shim -- "none" audio backend (CONFIG_SDLPOP_AUDIO_NONE).
 *
 * open() fails, so SDLPoP sets digi_unavailable and skips its entire
 * audio subsystem. The I2S backend (work-order §5a) replaces this
 * file at build time via Kconfig and implements the same six
 * functions for real: open spawns the feeder thread servicing the
 * game's callback into a double-buffered DMA ring.
 */

#include <zephyr/kernel.h>

#include "pop_shim.h"

int pop_audio_open(SDL_AudioSpec *desired, SDL_AudioSpec *obtained)
{
	ARG_UNUSED(desired);
	ARG_UNUSED(obtained);
	pop_set_error("audio: no backend (CONFIG_SDLPOP_AUDIO_NONE)");
	return -1;
}

void pop_audio_close(void)
{
}

void pop_audio_pause(int pause_on)
{
	ARG_UNUSED(pause_on);
}

void pop_audio_lock(void)
{
}

void pop_audio_unlock(void)
{
}

SDL_AudioStatus pop_audio_status(void)
{
	return SDL_AUDIO_STOPPED;
}
```

## src/shim_core.c
```c
/*
 * SPDX-License-Identifier: Apache-2.0
 *
 * PiZZa SDL2 shim -- init/error/version/hints, the single "window",
 * and misc surface-independent calls (messagebox, iconv, names).
 */

#include <zephyr/kernel.h>
#include <zephyr/logging/log.h>
#include <stdarg.h>
#include <stdio.h>

#include "pop_shim.h"

LOG_MODULE_REGISTER(pop_core, CONFIG_SDLPOP_LOG_LEVEL);

static char error_buf[192];

void pop_set_error(const char *fmt, ...)
{
	va_list ap;

	va_start(ap, fmt);
	vsnprintf(error_buf, sizeof(error_buf), fmt, ap);
	va_end(ap);
}

const char *SDL_GetError(void)
{
	return error_buf;
}

int SDL_Init(Uint32 flags)
{
	ARG_UNUSED(flags);
	return 0;
}

int SDL_InitSubSystem(Uint32 flags)
{
	ARG_UNUSED(flags);
	return 0;
}

void SDL_Quit(void)
{
}

SDL_bool SDL_SetHint(const char *name, const char *value)
{
	LOG_DBG("hint %s=%s", name, value);
	return SDL_TRUE;
}

void SDL_GetVersion(SDL_version *ver)
{
	SDL_VERSION(ver);
}

/* ── window ──────────────────────────────────────────────────── */

struct SDL_Window {
	int w, h;
	Uint32 flags;
};

static struct SDL_Window the_window;

SDL_Window *SDL_CreateWindow(const char *title, int x, int y, int w, int h, Uint32 flags)
{
	ARG_UNUSED(title);
	ARG_UNUSED(x);
	ARG_UNUSED(y);
	the_window.w = w;
	the_window.h = h;
	the_window.flags = flags;
	LOG_INF("window %dx%d flags 0x%08x", w, h, flags);
	return &the_window;
}

void SDL_GetWindowSize(SDL_Window *window, int *w, int *h)
{
	if (w != NULL) {
		*w = window->w;
	}
	if (h != NULL) {
		*h = window->h;
	}
}

Uint32 SDL_GetWindowFlags(SDL_Window *window)
{
	return window->flags;
}

int SDL_SetWindowFullscreen(SDL_Window *window, Uint32 flags)
{
	window->flags = (window->flags & ~SDL_WINDOW_FULLSCREEN_DESKTOP) | flags;
	return 0;
}

void SDL_SetWindowTitle(SDL_Window *window, const char *title)
{
	ARG_UNUSED(window);
	ARG_UNUSED(title);
}

void SDL_SetWindowIcon(SDL_Window *window, SDL_Surface *icon)
{
	ARG_UNUSED(window);
	ARG_UNUSED(icon);
}

void SDL_GL_GetDrawableSize(SDL_Window *window, int *w, int *h)
{
	SDL_GetWindowSize(window, w, h);
}

/* ── misc ────────────────────────────────────────────────────── */

int SDL_ShowSimpleMessageBox(Uint32 flags, const char *title, const char *message,
			     SDL_Window *window)
{
	ARG_UNUSED(flags);
	ARG_UNUSED(window);
	LOG_ERR("[%s] %s", title, message);
	return 0;
}

char *SDL_iconv_string(const char *tocode, const char *fromcode,
		       const char *inbuf, size_t inbytesleft)
{
	ARG_UNUSED(tocode);
	ARG_UNUSED(fromcode);

	/* UTF-8 passthrough suffices per the manifest (bucket A). */
	char *out = malloc(inbytesleft + 1);

	if (out == NULL) {
		return NULL;
	}
	memcpy(out, inbuf, inbytesleft);
	out[inbytesleft] = '\0';
	return out;
}

const char *SDL_GetPixelFormatName(Uint32 format)
{
	switch (format) {
	case SDL_PIXELFORMAT_INDEX8:
		return "SDL_PIXELFORMAT_INDEX8";
	case SDL_PIXELFORMAT_RGB24:
		return "SDL_PIXELFORMAT_RGB24";
	case SDL_PIXELFORMAT_ARGB8888:
		return "SDL_PIXELFORMAT_ARGB8888";
	default:
		return "SDL_PIXELFORMAT_UNKNOWN";
	}
}

const char *SDL_GetScancodeName(SDL_Scancode scancode)
{
	static const char *const letters[] = {
		"A", "B", "C", "D", "E", "F", "G", "H", "I", "J", "K", "L", "M",
		"N", "O", "P", "Q", "R", "S", "T", "U", "V", "W", "X", "Y", "Z",
	};
	static const char *const digits[] = {
		"1", "2", "3", "4", "5", "6", "7", "8", "9", "0",
	};

	if (scancode >= SDL_SCANCODE_A && scancode <= SDL_SCANCODE_Z) {
		return letters[scancode - SDL_SCANCODE_A];
	}
	if (scancode >= SDL_SCANCODE_1 && scancode <= SDL_SCANCODE_0) {
		return digits[scancode - SDL_SCANCODE_1];
	}
	switch (scancode) {
	case SDL_SCANCODE_RETURN:    return "Return";
	case SDL_SCANCODE_ESCAPE:    return "Escape";
	case SDL_SCANCODE_BACKSPACE: return "Backspace";
	case SDL_SCANCODE_TAB:       return "Tab";
	case SDL_SCANCODE_SPACE:     return "Space";
	case SDL_SCANCODE_LEFT:      return "Left";
	case SDL_SCANCODE_RIGHT:     return "Right";
	case SDL_SCANCODE_UP:        return "Up";
	case SDL_SCANCODE_DOWN:      return "Down";
	case SDL_SCANCODE_HOME:      return "Home";
	case SDL_SCANCODE_END:       return "End";
	case SDL_SCANCODE_PAGEUP:    return "PageUp";
	case SDL_SCANCODE_PAGEDOWN:  return "PageDown";
	case SDL_SCANCODE_DELETE:    return "Delete";
	case SDL_SCANCODE_LSHIFT:    return "Left Shift";
	case SDL_SCANCODE_RSHIFT:    return "Right Shift";
	case SDL_SCANCODE_LCTRL:     return "Left Ctrl";
	case SDL_SCANCODE_RCTRL:     return "Right Ctrl";
	case SDL_SCANCODE_LALT:      return "Left Alt";
	case SDL_SCANCODE_RALT:      return "Right Alt";
	default:                     return "";
	}
}
```

## src/shim_event.c
```c
/*
 * SPDX-License-Identifier: Apache-2.0
 *
 * PiZZa SDL2 shim -- event queue and keyboard state.
 *
 * Producer seam (work-order §5b): every source submits through
 * pop_event_submit() -- SDLPoP's own SDL_PushEvent (timer callbacks,
 * possibly from ISR context), the scripted input source (phase 4),
 * and the HOGP keyboard client later. The queue is a spinlock-guarded
 * ring so ISR producers are safe; the game consumes from the main
 * thread via SDL_PollEvent.
 *
 * KEYDOWN/KEYUP submissions update the persistent keyboard-state
 * array the game reads through SDL_GetKeyboardState().
 */

#include <zephyr/kernel.h>
#include <zephyr/spinlock.h>
#include <zephyr/logging/log.h>

#include "pop_shim.h"

LOG_MODULE_REGISTER(pop_event, CONFIG_SDLPOP_LOG_LEVEL);

#define POP_EVENT_QUEUE_LEN 64

static SDL_Event queue[POP_EVENT_QUEUE_LEN];
static uint32_t q_head;   /* next slot to read  */
static uint32_t q_count;  /* occupied slots     */
static struct k_spinlock q_lock;

static Uint8 key_state[SDL_NUM_SCANCODES];

int pop_event_submit(const SDL_Event *event)
{
	k_spinlock_key_t key = k_spin_lock(&q_lock);
	SDL_Event ev = *event;

	if (ev.type == SDL_KEYDOWN || ev.type == SDL_KEYUP) {
		SDL_Scancode sc = ev.key.keysym.scancode;

		if (sc > 0 && sc < SDL_NUM_SCANCODES) {
			key_state[sc] = (ev.type == SDL_KEYDOWN) ? 1 : 0;
		}

		/* Fill keysym.mod from the current held-modifier state so
		 * every producer (scripted, shell, future HOGP keyboard)
		 * gets correct Shift/Ctrl/Alt combos for free -- the game
		 * reads event.key.keysym.mod for e.g. Alt+Enter.
		 */
		Uint16 mod = 0;

		if (key_state[SDL_SCANCODE_LSHIFT]) { mod |= KMOD_LSHIFT; }
		if (key_state[SDL_SCANCODE_RSHIFT]) { mod |= KMOD_RSHIFT; }
		if (key_state[SDL_SCANCODE_LCTRL])  { mod |= KMOD_LCTRL; }
		if (key_state[SDL_SCANCODE_RCTRL])  { mod |= KMOD_RCTRL; }
		if (key_state[SDL_SCANCODE_LALT])   { mod |= KMOD_LALT; }
		if (key_state[SDL_SCANCODE_RALT])   { mod |= KMOD_RALT; }
		ev.key.keysym.mod = mod;
	}

	if (q_count == POP_EVENT_QUEUE_LEN) {
		k_spin_unlock(&q_lock, key);
		LOG_WRN("event queue full, dropping type 0x%x", ev.type);
		return -1;
	}

	queue[(q_head + q_count) % POP_EVENT_QUEUE_LEN] = ev;
	q_count++;
	k_spin_unlock(&q_lock, key);
	return 0;
}

int SDL_PushEvent(SDL_Event *event)
{
	return (pop_event_submit(event) == 0) ? 1 : 0;
}

int SDL_PollEvent(SDL_Event *event)
{
	k_spinlock_key_t key = k_spin_lock(&q_lock);

	if (q_count == 0) {
		k_spin_unlock(&q_lock, key);
		return 0;
	}

	if (event != NULL) {
		*event = queue[q_head];
	}
	q_head = (q_head + 1) % POP_EVENT_QUEUE_LEN;
	q_count--;
	k_spin_unlock(&q_lock, key);
	return 1;
}

const Uint8 *SDL_GetKeyboardState(int *numkeys)
{
	if (numkeys != NULL) {
		*numkeys = SDL_NUM_SCANCODES;
	}
	return key_state;
}

Uint32 SDL_GetMouseState(int *x, int *y)
{
	if (x != NULL) {
		*x = 0;
	}
	if (y != NULL) {
		*y = 0;
	}
	return 0;
}

void SDL_StartTextInput(void)
{
}

void SDL_StopTextInput(void)
{
}

void SDL_SetTextInputRect(const SDL_Rect *rect)
{
	ARG_UNUSED(rect);
}

int SDL_ShowCursor(int toggle)
{
	ARG_UNUSED(toggle);
	return SDL_DISABLE;
}
```

## src/shim_main.c
```c
/*
 * SPDX-License-Identifier: Apache-2.0
 *
 * PiZZa SDLPoP port -- Zephyr entry point.
 *
 * SDLPoP's own main() is renamed to SDL_main by the shim's SDL.h
 * (standard SDL trick); the Zephyr main thread becomes the game
 * thread. The game never returns in normal operation.
 */

#include <zephyr/kernel.h>
#include <stdio.h>

#include "pop_shim.h"

int main(void)
{
#if defined(CONFIG_SDLPOP_SIM_TUNING)
	/* Sim only: "megahit" enables cheats so the level-number arg is
	 * honored, "1" starts directly in level 1 -- skips the intro and
	 * title sequence, which TCG renders at ~1/80 real time. The
	 * scripted input then moves the Prince within seconds of boot.
	 */
	static char *argv[] = { "prince", "megahit", "1", NULL };
	int argc = 3;
#else
	static char *argv[] = { "prince", NULL };
	int argc = 1;
#endif

	printf("[sdlpop] PiZZa SDLPoP port, board %s\n", CONFIG_BOARD);

	if (IS_ENABLED(CONFIG_SDLPOP_VIDEO_SELFTEST)) {
		pop_video_selftest();
	}

	if (IS_ENABLED(CONFIG_SDLPOP_SCRIPTED_INPUT)) {
		pop_scripted_input_start();
	}

	printf("[sdlpop] starting game\n");

	int rc = SDL_main(argc, argv);

	printf("[sdlpop] game exited: %d\n", rc);
	return rc;
}
```

## src/shim_rw.c
```c
/*
 * SPDX-License-Identifier: Apache-2.0
 *
 * PiZZa SDL2 shim -- SDL_RWops.
 *
 * Memory-backed RWops are real (load_image feeds IMG_Load_RW through
 * SDL_RWFromConstMem). File-backed RWops land with the asset/FS
 * phase; SDLPoP only uses them for SDLPoP.cfg, so failing them is a
 * clean "no saved config" until then.
 */

#include <zephyr/kernel.h>

#include "pop_shim.h"

enum {
	POP_RW_MEM = 1,
	POP_RW_CONSTMEM,
};

static Sint64 mem_size(SDL_RWops *ctx)
{
	return ctx->mem.stop - ctx->mem.base;
}

static Sint64 mem_seek(SDL_RWops *ctx, Sint64 offset, int whence)
{
	Uint8 *target;

	switch (whence) {
	case RW_SEEK_SET:
		target = ctx->mem.base + offset;
		break;
	case RW_SEEK_CUR:
		target = ctx->mem.here + offset;
		break;
	case RW_SEEK_END:
		target = ctx->mem.stop + offset;
		break;
	default:
		pop_set_error("RW mem_seek: bad whence %d", whence);
		return -1;
	}
	if (target < ctx->mem.base) {
		target = ctx->mem.base;
	}
	if (target > ctx->mem.stop) {
		target = ctx->mem.stop;
	}
	ctx->mem.here = target;
	return ctx->mem.here - ctx->mem.base;
}

static size_t mem_read(SDL_RWops *ctx, void *ptr, size_t size, size_t maxnum)
{
	if (size == 0 || maxnum == 0) {
		return 0;
	}

	size_t avail = (size_t)(ctx->mem.stop - ctx->mem.here);
	size_t want = size * maxnum;
	size_t take = MIN(want, avail);
	size_t num = take / size;

	memcpy(ptr, ctx->mem.here, num * size);
	ctx->mem.here += num * size;
	return num;
}

static size_t mem_write(SDL_RWops *ctx, const void *ptr, size_t size, size_t num)
{
	if (ctx->type == POP_RW_CONSTMEM) {
		pop_set_error("RW mem_write: const memory");
		return 0;
	}

	size_t avail = (size_t)(ctx->mem.stop - ctx->mem.here);
	size_t take = MIN(size * num, avail);
	size_t n = take / size;

	memcpy(ctx->mem.here, ptr, n * size);
	ctx->mem.here += n * size;
	return n;
}

static int mem_close(SDL_RWops *ctx)
{
	free(ctx);
	return 0;
}

static SDL_RWops *rw_from_mem(void *mem, int size, Uint32 type)
{
	if (mem == NULL || size <= 0) {
		pop_set_error("RWFromMem: bad buffer");
		return NULL;
	}

	SDL_RWops *rw = calloc(1, sizeof(*rw));

	if (rw == NULL) {
		pop_set_error("RWFromMem: out of memory");
		return NULL;
	}
	rw->size = mem_size;
	rw->seek = mem_seek;
	rw->read = mem_read;
	rw->write = mem_write;
	rw->close = mem_close;
	rw->type = type;
	rw->mem.base = mem;
	rw->mem.here = mem;
	rw->mem.stop = (Uint8 *)mem + size;
	return rw;
}

SDL_RWops *SDL_RWFromMem(void *mem, int size)
{
	return rw_from_mem(mem, size, POP_RW_MEM);
}

SDL_RWops *SDL_RWFromConstMem(const void *mem, int size)
{
	return rw_from_mem((void *)mem, size, POP_RW_CONSTMEM);
}

SDL_RWops *SDL_RWFromFile(const char *file, const char *mode)
{
	ARG_UNUSED(mode);
	/* PHASE1-STUB: file-backed RW (SDLPoP.cfg) lands with the FS phase */
	pop_set_error("RWFromFile: no filesystem backend yet (%s)", file);
	return NULL;
}

size_t SDL_RWread(SDL_RWops *ctx, void *ptr, size_t size, size_t maxnum)
{
	return ctx->read(ctx, ptr, size, maxnum);
}

size_t SDL_RWwrite(SDL_RWops *ctx, const void *ptr, size_t size, size_t num)
{
	return ctx->write(ctx, ptr, size, num);
}

Sint64 SDL_RWtell(SDL_RWops *ctx)
{
	return ctx->seek(ctx, 0, RW_SEEK_CUR);
}

int SDL_RWclose(SDL_RWops *ctx)
{
	return ctx->close(ctx);
}
```

## src/shim_scripted.c
```c
/*
 * SPDX-License-Identifier: Apache-2.0
 *
 * PiZZa SDLPoP port -- scripted input source
 * (CONFIG_SDLPOP_SCRIPTED_INPUT).
 *
 * A synthetic input producer that drives the game headless through
 * the same shim_event.c producer seam the HOGP keyboard client will
 * use later (work-order §5b). It runs on its own thread and injects
 * a timeline of key press/release events on wall-clock (k_uptime),
 * demonstrating: timing works, the event queue accepts an external
 * producer, and a scripted sequence moves the character.
 *
 * Timeline (ms from game start): dismiss the intro/title screens,
 * start level 1, then run the Prince right and jump -- a visible,
 * deterministic motion sequence for the phase-4 frame capture.
 */

#include <zephyr/kernel.h>
#include <zephyr/logging/log.h>

#include "pop_shim.h"

LOG_MODULE_REGISTER(pop_scripted, CONFIG_SDLPOP_LOG_LEVEL);

struct script_step {
	uint32_t at_ms;
	SDL_Scancode scancode;
	bool down;
};

/* Under CONFIG_SDLPOP_SIM_TUNING the game boots straight into level 1
 * (megahit + level arg in shim_main.c), so no intro/title to dismiss.
 * The Prince stands facing left in the level-1 start room; tapping
 * Right turns him, holding Right runs him toward the gate; Up is a
 * standing jump. Each key: press, hold, release.
 */
static const struct script_step timeline[] = {
	/* dismiss any level-start prompt */
	{ 1500,  SDL_SCANCODE_RETURN, true },  { 1600,  SDL_SCANCODE_RETURN, false },
	/* turn + run right */
	{ 2500,  SDL_SCANCODE_RIGHT, true },   { 5000,  SDL_SCANCODE_RIGHT, false },
	/* standing jump */
	{ 5500,  SDL_SCANCODE_UP, true },      { 5900,  SDL_SCANCODE_UP, false },
	/* run right again */
	{ 6500,  SDL_SCANCODE_RIGHT, true },   { 9000,  SDL_SCANCODE_RIGHT, false },
};

static K_THREAD_STACK_DEFINE(scripted_stack, 2048);
static struct k_thread scripted_thread;

static void push_key(SDL_Scancode sc, bool down)
{
	SDL_Event ev;

	memset(&ev, 0, sizeof(ev));
	ev.type = down ? SDL_KEYDOWN : SDL_KEYUP;
	ev.key.state = down ? SDL_PRESSED : SDL_RELEASED;
	ev.key.keysym.scancode = sc;
	pop_event_submit(&ev);
}

static void scripted_run(void *a, void *b, void *c)
{
	ARG_UNUSED(a);
	ARG_UNUSED(b);
	ARG_UNUSED(c);

	int64_t t0 = k_uptime_get();

	for (size_t i = 0; i < ARRAY_SIZE(timeline); i++) {
		int64_t due = t0 + timeline[i].at_ms;
		int64_t now = k_uptime_get();

		if (due > now) {
			k_msleep((int32_t)(due - now));
		}
		push_key(timeline[i].scancode, timeline[i].down);
		LOG_DBG("scripted: t=%u sc=%d %s", timeline[i].at_ms,
			timeline[i].scancode, timeline[i].down ? "down" : "up");
	}
	LOG_INF("scripted: timeline complete");
}

void pop_scripted_input_start(void)
{
	k_thread_create(&scripted_thread, scripted_stack,
			K_THREAD_STACK_SIZEOF(scripted_stack),
			scripted_run, NULL, NULL, NULL,
			K_PRIO_PREEMPT(7), 0, K_NO_WAIT);
	k_thread_name_set(&scripted_thread, "pop_scripted");
}
```

## src/shim_selftest.c
```c
/*
 * SPDX-License-Identifier: Apache-2.0
 *
 * PiZZa SDLPoP port -- video-path self-test
 * (CONFIG_SDLPOP_VIDEO_SELFTEST).
 *
 * Runs before the game starts and drives the exact API path SDLPoP's
 * update_screen() uses -- CreateWindow/CreateRenderer, a 24bpp
 * surface composed with SDL_FillRect + direct pixel writes,
 * UpdateTexture, RenderCopy, RenderPresent. Output: classic color
 * bars + a gray ramp + a 16-step strip. On hardware this paints the
 * HDMI panel via the HVS-scaled fb (phase-6 eyeball); on sim the
 * capture backend dumps it for the phase-2 gate.
 */

#include <zephyr/kernel.h>
#include <zephyr/logging/log.h>

#include "pop_shim.h"

LOG_MODULE_REGISTER(pop_selftest, CONFIG_SDLPOP_LOG_LEVEL);

/* SDLPoP's LE 24bpp masks (types.h): R low byte. */
#define POP_RMSK 0x000000FF
#define POP_GMSK 0x0000FF00
#define POP_BMSK 0x00FF0000

void pop_video_selftest(void)
{
	LOG_INF("selftest: video path");

	SDL_Window *win = SDL_CreateWindow("selftest", SDL_WINDOWPOS_UNDEFINED,
					   SDL_WINDOWPOS_UNDEFINED, 320, 200, 0);
	SDL_Renderer *ren = SDL_CreateRenderer(win, -1, 0);
	SDL_Surface *surf = SDL_CreateRGBSurface(0, 320, 200, 24,
						 POP_RMSK, POP_GMSK, POP_BMSK, 0);
	SDL_Texture *tex = SDL_CreateTexture(ren, SDL_PIXELFORMAT_RGB24,
					     SDL_TEXTUREACCESS_STREAMING, 320, 200);

	if (ren == NULL || surf == NULL || tex == NULL) {
		LOG_ERR("selftest: setup failed: %s", SDL_GetError());
		return;
	}

	/* Rows 0..139: 8 color bars (white yellow cyan green magenta
	 * red blue black), 40 px each.
	 */
	static const Uint8 bars[8][3] = {
		{ 255, 255, 255 }, { 255, 255, 0 }, { 0, 255, 255 }, { 0, 255, 0 },
		{ 255, 0, 255 }, { 255, 0, 0 }, { 0, 0, 255 }, { 0, 0, 0 },
	};

	for (int i = 0; i < 8; i++) {
		SDL_Rect r = { i * 40, 0, 40, 140 };
		Uint32 c = SDL_MapRGB(surf->format, bars[i][0], bars[i][1], bars[i][2]);

		SDL_FillRect(surf, &r, c);
	}

	/* Rows 140..169: horizontal gray ramp, direct pixel writes
	 * through Lock/Unlock like decode_image does.
	 */
	SDL_LockSurface(surf);
	for (int y = 140; y < 170; y++) {
		Uint8 *px = (Uint8 *)surf->pixels + (size_t)y * surf->pitch;

		for (int x = 0; x < 320; x++) {
			Uint8 v = (Uint8)((x * 255) / 319);

			px[0] = v;
			px[1] = v;
			px[2] = v;
			px += 3;
		}
	}
	SDL_UnlockSurface(surf);

	/* Rows 170..199: 16-step strip (VGA-palette-ish hues). */
	for (int i = 0; i < 16; i++) {
		SDL_Rect r = { i * 20, 170, 20, 30 };
		Uint32 c = SDL_MapRGB(surf->format,
				      (Uint8)(i * 17),
				      (Uint8)(255 - i * 17),
				      (Uint8)((i & 3) * 85));

		SDL_FillRect(surf, &r, c);
	}

	SDL_UpdateTexture(tex, NULL, surf->pixels, surf->pitch);
	SDL_RenderCopy(ren, tex, NULL, NULL);
	SDL_RenderPresent(ren);

	/* Hold the bars on the panel long enough to eyeball -- this is the
	 * phase-6 sign-off for the present path and, crucially, R/B channel
	 * order (leftmost bar must read WHITE then the color order
	 * white/yellow/cyan/green/magenta/red/blue/black). Re-present a few
	 * times across the hold so a dropped frame can't leave it blank.
	 */
	LOG_INF("selftest: holding color bars %d ms -- check leftmost bar is WHITE, "
		"then yellow/cyan/green/magenta/RED/BLUE/black",
		CONFIG_SDLPOP_SELFTEST_HOLD_MS);
	for (int elapsed = 0; elapsed < CONFIG_SDLPOP_SELFTEST_HOLD_MS; elapsed += 500) {
		SDL_UpdateTexture(tex, NULL, surf->pixels, surf->pitch);
		SDL_RenderCopy(ren, tex, NULL, NULL);
		SDL_RenderPresent(ren);
		SDL_Delay(500);
	}

	SDL_FreeSurface(surf);
	LOG_INF("selftest: color bars done");
}
```
