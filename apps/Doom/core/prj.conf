## CMakeLists.txt
```
# SPDX-License-Identifier: Apache-2.0
#
# PiZZa -- sdl2-doom built as a loadable libretro content core (doom.llext).
#
# Same game + shim composition as the app build (apps/Doom), minus
# everything the frontend owns (present backend, shell, USB, baked IWAD,
# Zephyr main) and plus the sdl2shim-over-libretro glue, which supplies
# the retro_* ABI, the present seam, input synthesis and the audio pump.
# The WAD is NOT baked: this is a need_fullpath content core that reads
# the launcher-picked file off the filesystem (doom_core_fs.c). First
# light builds no OPL music (see prj.conf). Build against the SAME board
# as the frontend, then `west build -t doom_core` produces doom.llext.
#
# sdl2-doom is GPL-2.0; this binary is GPL-2.0 by linking it. The shim +
# port glue are Apache-2.0.

cmake_minimum_required(VERSION 3.20.0)
find_package(Zephyr REQUIRED HINTS $ENV{ZEPHYR_BASE})
project(pizza_doom_core LANGUAGES C ASM)

set(DOOM_DIR ${CMAKE_CURRENT_SOURCE_DIR}/..)

# ── Doom game tree (untouched checkout) ─────────────────────────────
if(NOT DEFINED DOOM_SRC_DIR)
  set(DOOM_SRC_DIR "$ENV{HOME}/github/sdl2-doom/src")
endif()
if(NOT EXISTS "${DOOM_SRC_DIR}/d_main.c")
  message(FATAL_ERROR
    "sdl2-doom sources not found at ${DOOM_SRC_DIR}. Clone "
    "https://github.com/AlexOberhofer/sdl2-doom and keep it at "
    "~/github/sdl2-doom or pass -DDOOM_SRC_DIR=<path>.")
endif()

# The fork's build list minus i_cdmus.c (SDL 1.2 CD API) and i_video.c
# (fed in rewritten below). OPL off -> the original i_sound.c stays.
set(DOOM_GAME_SRC
  ${DOOM_SRC_DIR}/i_main.c ${DOOM_SRC_DIR}/dummy.c ${DOOM_SRC_DIR}/am_map.c
  ${DOOM_SRC_DIR}/doomdef.c ${DOOM_SRC_DIR}/doomstat.c ${DOOM_SRC_DIR}/dstrings.c
  ${DOOM_SRC_DIR}/d_event.c ${DOOM_SRC_DIR}/d_items.c ${DOOM_SRC_DIR}/d_iwad.c
  ${DOOM_SRC_DIR}/d_loop.c ${DOOM_SRC_DIR}/d_main.c ${DOOM_SRC_DIR}/d_mode.c
  ${DOOM_SRC_DIR}/d_net.c ${DOOM_SRC_DIR}/f_finale.c ${DOOM_SRC_DIR}/f_wipe.c
  ${DOOM_SRC_DIR}/g_game.c ${DOOM_SRC_DIR}/hu_lib.c ${DOOM_SRC_DIR}/hu_stuff.c
  ${DOOM_SRC_DIR}/info.c ${DOOM_SRC_DIR}/i_endoom.c ${DOOM_SRC_DIR}/i_joystick.c
  ${DOOM_SRC_DIR}/i_scale.c ${DOOM_SRC_DIR}/i_sound.c ${DOOM_SRC_DIR}/i_sdlmusic.c
  ${DOOM_SRC_DIR}/i_sdlsound.c ${DOOM_SRC_DIR}/i_system.c ${DOOM_SRC_DIR}/i_timer.c
  ${DOOM_SRC_DIR}/i_input.c ${DOOM_SRC_DIR}/mus2mid.c ${DOOM_SRC_DIR}/memio.c
  ${DOOM_SRC_DIR}/m_argv.c ${DOOM_SRC_DIR}/m_bbox.c ${DOOM_SRC_DIR}/m_cheat.c
  ${DOOM_SRC_DIR}/m_config.c ${DOOM_SRC_DIR}/m_controls.c ${DOOM_SRC_DIR}/m_fixed.c
  ${DOOM_SRC_DIR}/m_menu.c ${DOOM_SRC_DIR}/m_misc.c ${DOOM_SRC_DIR}/m_random.c
  ${DOOM_SRC_DIR}/p_ceilng.c ${DOOM_SRC_DIR}/p_doors.c ${DOOM_SRC_DIR}/p_enemy.c
  ${DOOM_SRC_DIR}/p_floor.c ${DOOM_SRC_DIR}/p_inter.c ${DOOM_SRC_DIR}/p_lights.c
  ${DOOM_SRC_DIR}/p_map.c ${DOOM_SRC_DIR}/p_maputl.c ${DOOM_SRC_DIR}/p_mobj.c
  ${DOOM_SRC_DIR}/p_plats.c ${DOOM_SRC_DIR}/p_pspr.c ${DOOM_SRC_DIR}/p_saveg.c
  ${DOOM_SRC_DIR}/p_setup.c ${DOOM_SRC_DIR}/p_sight.c ${DOOM_SRC_DIR}/p_spec.c
  ${DOOM_SRC_DIR}/p_switch.c ${DOOM_SRC_DIR}/p_telept.c ${DOOM_SRC_DIR}/p_tick.c
  ${DOOM_SRC_DIR}/p_user.c ${DOOM_SRC_DIR}/r_bsp.c ${DOOM_SRC_DIR}/r_data.c
  ${DOOM_SRC_DIR}/r_draw.c ${DOOM_SRC_DIR}/r_main.c ${DOOM_SRC_DIR}/r_plane.c
  ${DOOM_SRC_DIR}/r_segs.c ${DOOM_SRC_DIR}/r_sky.c ${DOOM_SRC_DIR}/r_things.c
  ${DOOM_SRC_DIR}/sha1.c ${DOOM_SRC_DIR}/sounds.c ${DOOM_SRC_DIR}/statdump.c
  ${DOOM_SRC_DIR}/st_lib.c ${DOOM_SRC_DIR}/st_stuff.c ${DOOM_SRC_DIR}/s_sound.c
  ${DOOM_SRC_DIR}/tables.c ${DOOM_SRC_DIR}/v_video.c ${DOOM_SRC_DIR}/wi_stuff.c
  ${DOOM_SRC_DIR}/w_checksum.c ${DOOM_SRC_DIR}/w_file.c ${DOOM_SRC_DIR}/w_main.c
  ${DOOM_SRC_DIR}/w_wad.c ${DOOM_SRC_DIR}/z_zone.c ${DOOM_SRC_DIR}/w_file_stdc.c
)

# i_video.c rewritten to native 320x200 (SDL_RESX/Y *3 -> plain; the HVS
# upscales). Keeps the checkout pristine -- the whole delta is this sed.
set(DOOM_IVIDEO_GEN ${CMAKE_BINARY_DIR}/gen/i_video_320.c)
add_custom_command(
  OUTPUT ${DOOM_IVIDEO_GEN}
  COMMAND ${CMAKE_COMMAND} -E make_directory ${CMAKE_BINARY_DIR}/gen
  COMMAND ${CMAKE_COMMAND} -E copy ${DOOM_SRC_DIR}/i_video.c ${DOOM_IVIDEO_GEN}
  COMMAND sed -i.bak
          -e "s|#define SDL_RESX 320 \\* 3|#define SDL_RESX 320|"
          -e "s|#define SDL_RESY 200 \\* 3|#define SDL_RESY 200|"
          ${DOOM_IVIDEO_GEN}
  DEPENDS ${DOOM_SRC_DIR}/i_video.c
  COMMENT "Rewriting i_video.c to native 320x200 (HVS upscales)"
  VERBATIM
)
list(APPEND DOOM_GAME_SRC ${DOOM_IVIDEO_GEN})

# ── OPL music (CONFIG_DOOM_MUSIC_OPL) ───────────────────────────────
# Mirror the app build (apps/Doom/CMakeLists.txt). The fork hardcodes
# music_sdl_module (stubbed silent in shim_mixer.c); swap it to
# music_opl_module via a pristine-checkout sed (same discipline as the
# i_video rewrite), and pull Chocolate Doom's OPL synth + opl_glue.c into
# the llext. The synth folds into the shared mixer as a MIX_CHANNEL_POST
# effect -- the seam SFX already proves. The MUS->MIDI temp round-trip is
# RAM-backed in doom_core_fs.c (the core's fs is the real SD card).
set(DOOM_OPL_SRC "")
set(DOOM_OPL_GLUE "")
set(DOOM_OPL_INC "")
if(CONFIG_DOOM_MUSIC_OPL)
  list(REMOVE_ITEM DOOM_GAME_SRC ${DOOM_SRC_DIR}/i_sound.c)
  set(DOOM_ISOUND_GEN ${CMAKE_BINARY_DIR}/gen/i_sound_opl.c)
  add_custom_command(
    OUTPUT ${DOOM_ISOUND_GEN}
    COMMAND ${CMAKE_COMMAND} -E make_directory ${CMAKE_BINARY_DIR}/gen
    COMMAND ${CMAKE_COMMAND} -E copy ${DOOM_SRC_DIR}/i_sound.c ${DOOM_ISOUND_GEN}
    COMMAND sed -i.bak
            -e "s|music_module = &music_sdl_module|music_module = \\&music_opl_module|"
            ${DOOM_ISOUND_GEN}
    DEPENDS ${DOOM_SRC_DIR}/i_sound.c
    COMMENT "Selecting OPL music module (music_sdl -> music_opl)"
    VERBATIM
  )
  list(APPEND DOOM_GAME_SRC ${DOOM_ISOUND_GEN})

  if(NOT DEFINED CHOCOLATE_SRC_DIR)
    set(CHOCOLATE_SRC_DIR "$ENV{HOME}/github/chocolate-doom")
  endif()
  if(NOT EXISTS "${CHOCOLATE_SRC_DIR}/opl/opl3.c")
    message(FATAL_ERROR
      "OPL music needs chocolate-doom at ${CHOCOLATE_SRC_DIR} "
      "(opl/ + src/i_oplmusic.c). Pass -DCHOCOLATE_SRC_DIR=<path>.")
  endif()
  set(DOOM_OPL_SRC
    ${CHOCOLATE_SRC_DIR}/opl/opl.c
    ${CHOCOLATE_SRC_DIR}/opl/opl3.c
    ${CHOCOLATE_SRC_DIR}/opl/opl_queue.c
    ${CHOCOLATE_SRC_DIR}/opl/opl_sdl.c
    ${CHOCOLATE_SRC_DIR}/src/midifile.c
    ${CHOCOLATE_SRC_DIR}/src/i_oplmusic.c
  )
  set(DOOM_OPL_GLUE ${DOOM_DIR}/src/opl_glue.c)
  set(DOOM_OPL_INC ${CHOCOLATE_SRC_DIR}/opl ${CHOCOLATE_SRC_DIR}/src)
endif()

# ── shim ────────────────────────────────────────────────────────────
include(${DOOM_DIR}/../lib/sdl2shim/sdl2shim.cmake)

add_llext_target(doom_core
	OUTPUT  ${PROJECT_BINARY_DIR}/doom.llext
	SOURCES
	  ${DOOM_GAME_SRC}
	  ${DOOM_DIR}/src/shim_video.c
	  ${DOOM_DIR}/src/shim_mixer.c
	  src/doom_core_fs.c
	  src/doom_retro_desc.c
	  ${SDL2SHIM_CORE_SOURCES}
	  ${SDL2SHIM_LIBRETRO_SOURCES}
	  ${DOOM_OPL_SRC}
	  ${DOOM_OPL_GLUE}
)

llext_include_directories(doom_core
	${SDL2SHIM_INCLUDE_DIRS}
	${SDL2SHIM_DIR}/include/SDL2
	${DOOM_DIR}/src
	${DOOM_SRC_DIR}/../include
	${DOOM_SRC_DIR}
	${DOOM_OPL_INC}
)

llext_compile_options(doom_core
	-D__PICOLIBC_ERRNO_FUNCTION=s2s_core_errno_ptr
	-Wno-unused-variable
	-Wno-unused-but-set-variable
	-Wno-unused-parameter
	-Wno-unused-function
	-Wno-missing-braces
	-Wno-missing-field-initializers
	-Wno-missing-prototypes
	-Wno-double-promotion
	-Wno-format-truncation
)

# Game TUs assume glibc (strcasecmp/alloca via string.h/stdlib.h);
# picolibc keeps them in <strings.h>/<alloca.h>. FEATURE_SOUND gates the
# SFX module table (set from the makefile in the upstream build, not
# config.h). Same set as the app build.
set_source_files_properties(${DOOM_GAME_SRC} PROPERTIES COMPILE_OPTIONS
  "-Wno-maybe-uninitialized;-Wno-implicit-fallthrough;-Wno-format;-Wno-int-conversion;-include;strings.h;-include;alloca.h;-D_DEFAULT_SOURCE;-DFEATURE_SOUND"
)

# i_main.c defines main(argc,argv) without including <SDL2/SDL.h>, so the
# header's main->SDL_main redirect can't reach it; force it so the glue's
# SDL_main entry is this TU's main.
set_source_files_properties(${DOOM_SRC_DIR}/i_main.c PROPERTIES
  COMPILE_DEFINITIONS "main=SDL_main")

# Chocolate OPL TUs need the glibc-ism relief the game TUs get. opl_glue.c
# is ours (Zephyr-native) and rides the core-wide llext options instead.
if(CONFIG_DOOM_MUSIC_OPL)
  set(OPL_FLAGS "-Wno-unused-variable;-Wno-unused-but-set-variable;-Wno-unused-function;-Wno-missing-braces;-Wno-implicit-fallthrough;-Wno-format;-Wno-maybe-uninitialized;-Wno-int-conversion;-include;strings.h;-D_DEFAULT_SOURCE")
  set_source_files_properties(${DOOM_OPL_SRC} PROPERTIES COMPILE_OPTIONS "${OPL_FLAGS}")
endif()

target_sources(app PRIVATE src/empty.c)
```

## Kconfig
```
# SPDX-License-Identifier: Apache-2.0
#
# doom core build -- pulls the shim Kconfig for the SDL2SHIM_* symbols
# the shim TUs compile against (log level, libretro app stack). The
# audio-backend choice is irrelevant here (the core links the libretro
# audio pump directly).

rsource "../../lib/sdl2shim/Kconfig"

config DOOM_MUSIC_OPL
	bool "OPL2/OPL3 FM music (Chocolate Doom synth via GENMIDI)"
	default n
	help
	  Compile Chocolate Doom's OPL subsystem into the core (Nuked OPL3
	  emulator + i_oplmusic sequencer, referenced from CHOCOLATE_SRC_DIR)
	  and fold the synth into the shared mixer as a MIX_CHANNEL_POST
	  effect -- the same seam SFX already uses. Instruments come from the
	  WAD's GENMIDI lump; no external data. Mirrors the app build's
	  CONFIG_DOOM_MUSIC_OPL. The MUS->MIDI temp round-trip is RAM-backed
	  in doom_core_fs.c.

source "Kconfig.zephyr"
```

## prj.conf
```kconfig
# SPDX-License-Identifier: Apache-2.0
#
# doom.llext core build. The zephyr.bin here is a discarded dummy; these
# options give the llext TUs the same compile environment as the
# frontend image that hosts them, minus TLS (the TLS-free-core rule) and
# C++ (sdl2-doom is pure C -- no cxxrt, no COMDAT flag). See
# apps/sokoban/core/prj.conf and the M5 handover.

CONFIG_LLEXT=y
CONFIG_LLEXT_TYPE_ELF_RELOCATABLE=y

CONFIG_THREAD_LOCAL_STORAGE=n

CONFIG_FPU=y

# First light builds no OPL music (fewer TUs, no chocolate dependency,
# faster to a rendered frame) -- that is hardcoded in this core's
# CMakeLists, not a Kconfig choice. SFX stays silent regardless: the
# frontend drops audio_batch_cb until M6.
```

## src/doom_core_fs.c
```c
/*
 * SPDX-License-Identifier: Apache-2.0
 *
 * PiZZa sdl2-doom libretro core -- filesystem-backed stdio.
 *
 * The app build bakes the IWAD into rodata and serves it through a POSIX
 * fd layer (doom_assets.c). The CORE build instead reads the WAD the
 * launcher picked off /SD:/roms (need_fullpath): the glue hands the game
 * "core -iwad <path>", and Doom fopen()s that path.
 *
 * Approach 2 (see the M5 handover + the sokoban rule-4 precedent): an
 * IMPORTED picolibc fopen would funnel to the FRONTEND's open(), never
 * this core's -- so the core DEFINES the stdio surface Doom's WAD path
 * uses (fopen/fread/fseek/ftell/fclose, plus fwrite for saves/config)
 * and binds it at partial link, calling straight through to the
 * frontend's exported fs_*. A private FILE is sufficient: Doom treats
 * the handle opaquely (w_file_stdc.c / m_misc.c), and the feof/fscanf
 * loops that would touch picolibc's real FILE fields sit behind a
 * successful fopen of files that do not exist on a WAD-only card.
 *
 * Validated in isolation first by apps/retro/corefstest (fstest.llext),
 * which shares this exact layer.
 */

#include <zephyr/kernel.h>
#include <zephyr/fs/fs.h>
#include <errno.h>
#include <stdio.h>
#include <stdint.h>
#include <string.h>

struct core_file {
	struct fs_file_t f;
	bool is_temp; /* RAM-backed doom.mid, not an fs file */
	size_t pos;   /* cursor for the temp file */
};

/* OPL music round-trips each song through a "doom.mid" temp file
 * (i_oplmusic: MUS -> mus2mid -> M_WriteFile -> MIDI_LoadFile), and both
 * the write and the read funnel through this stdio layer. The core's fs is
 * the real SD card and a relative temp path has no mount point, so back
 * that ONE path with RAM -- the write and the read see the same bytes.
 * Mirrors the app's doom_assets.c. 96 KiB = i_oplmusic's MAXMIDLENGTH.
 */
#define MID_MAX (96 * 1024)
static uint8_t mid_buf[MID_MAX];
static size_t mid_len;

static bool is_temp(const char *path)
{
	size_t n, k;

	if (path == NULL) {
		return false;
	}
	n = strlen(path);
	k = strlen("doom.mid");
	if (n < k) {
		return false;
	}
	path += n - k;
	for (size_t i = 0; i < k; i++) {
		char a = path[i];
		char b = "doom.mid"[i];

		if (a >= 'A' && a <= 'Z') {
			a += 'a' - 'A';
		}
		if (a != b) {
			return false;
		}
	}
	return true;
}

static int mode_to_flags(const char *mode)
{
	if (mode[0] == 'w') {
		return FS_O_WRITE | FS_O_CREATE | FS_O_TRUNC;
	}
	if (mode[0] == 'a') {
		return FS_O_WRITE | FS_O_CREATE | FS_O_APPEND;
	}
	return FS_O_READ;
}

FILE *fopen(const char *path, const char *mode)
{
	struct core_file *cf = malloc(sizeof(*cf));
	int rc;

	if (cf == NULL) {
		errno = ENOMEM;
		return NULL;
	}

	if (is_temp(path)) {
		cf->is_temp = true;
		cf->pos = 0;
		if (mode[0] == 'w') {
			mid_len = 0; /* truncate on write-open */
		}
		return (FILE *)cf;
	}

	cf->is_temp = false;
	fs_file_t_init(&cf->f);
	rc = fs_open(&cf->f, path, mode_to_flags(mode));
	if (rc != 0) {
		free(cf);
		errno = (rc < 0) ? -rc : ENOENT;
		return NULL;
	}
	return (FILE *)cf;
}

int fclose(FILE *stream)
{
	struct core_file *cf = (struct core_file *)stream;

	if (cf == NULL) {
		return -1;
	}
	if (!cf->is_temp) {
		fs_close(&cf->f);
	}
	free(cf);
	return 0;
}

size_t fread(void *ptr, size_t size, size_t nmemb, FILE *stream)
{
	struct core_file *cf = (struct core_file *)stream;
	ssize_t rd;

	if (cf == NULL || size == 0) {
		return 0;
	}
	if (cf->is_temp) {
		size_t want = size * nmemb;
		size_t avail = (cf->pos < mid_len) ? mid_len - cf->pos : 0;
		size_t n = (want < avail) ? want : avail;

		memcpy(ptr, mid_buf + cf->pos, n);
		cf->pos += n;
		return n / size;
	}
	rd = fs_read(&cf->f, ptr, size * nmemb);
	if (rd <= 0) {
		return 0;
	}
	return (size_t)rd / size;
}

/* Chocolate midifile.c parses the MIDI stream one byte at a time through
 * fgetc (ReadByte). fgetc is NOT one of the six functions this layer
 * overrides, so without this it would bind to the frontend's picolibc
 * fgetc, which would read our struct core_file as a picolibc FILE and
 * dereference garbage. Define it here over the same handle. (Doom never
 * reads stdin, so a core-wide fgetc is safe.)
 */
int fgetc(FILE *stream)
{
	struct core_file *cf = (struct core_file *)stream;
	unsigned char c;

	if (cf == NULL) {
		return EOF;
	}
	if (cf->is_temp) {
		if (cf->pos >= mid_len) {
			return EOF;
		}
		return (int)mid_buf[cf->pos++];
	}
	if (fs_read(&cf->f, &c, 1) != 1) {
		return EOF;
	}
	return (int)c;
}

size_t fwrite(const void *ptr, size_t size, size_t nmemb, FILE *stream)
{
	struct core_file *cf = (struct core_file *)stream;
	ssize_t wr;

	if (cf == NULL || size == 0) {
		return 0;
	}
	if (cf->is_temp) {
		size_t want = size * nmemb;
		size_t space = (cf->pos < MID_MAX) ? MID_MAX - cf->pos : 0;
		size_t n = (want < space) ? want : space;

		memcpy(mid_buf + cf->pos, ptr, n);
		cf->pos += n;
		if (cf->pos > mid_len) {
			mid_len = cf->pos;
		}
		return n / size;
	}
	wr = fs_write(&cf->f, ptr, size * nmemb);
	if (wr <= 0) {
		return 0;
	}
	return (size_t)wr / size;
}

int fseek(FILE *stream, long offset, int whence)
{
	struct core_file *cf = (struct core_file *)stream;
	int w;

	if (cf == NULL) {
		return -1;
	}
	if (cf->is_temp) {
		long base;
		long np;

		switch (whence) {
		case SEEK_SET:
			base = 0;
			break;
		case SEEK_CUR:
			base = (long)cf->pos;
			break;
		case SEEK_END:
			base = (long)mid_len;
			break;
		default:
			return -1;
		}
		np = base + offset;
		if (np < 0 || np > (long)MID_MAX) {
			return -1;
		}
		cf->pos = (size_t)np;
		return 0;
	}
	switch (whence) {
	case SEEK_SET:
		w = FS_SEEK_SET;
		break;
	case SEEK_CUR:
		w = FS_SEEK_CUR;
		break;
	case SEEK_END:
		w = FS_SEEK_END;
		break;
	default:
		return -1;
	}
	return fs_seek(&cf->f, offset, w) == 0 ? 0 : -1;
}

long ftell(FILE *stream)
{
	struct core_file *cf = (struct core_file *)stream;

	if (cf == NULL) {
		return -1;
	}
	if (cf->is_temp) {
		return (long)cf->pos;
	}
	return (long)fs_tell(&cf->f);
}
```

## src/doom_retro_desc.c
```c
/*
 * SPDX-License-Identifier: Apache-2.0
 *
 * sdl2-doom core descriptor for the sdl2shim-over-libretro glue.
 *
 * Content core: the launcher browses /SD:/roms for "*.wad", and the glue
 * runs the game as "core -iwad <picked path>" (need_fullpath -- Doom
 * opens the file itself, doom_core_fs.c). Geometry is Doom's native
 * 320x200; the HVS upscales on hardware. Retropad -> Doom's default
 * keys (m_controls.c): arrows move/turn, A fire (LCTRL), B use (SPACE),
 * START/SELECT drive the menu, shoulders strafe.
 */

#include <SDL2/SDL.h>
#include <libretro.h>

#include "sdl2shim_libretro.h"

static const struct s2s_libretro_keybind doom_keymap[] = {
	{ RETRO_DEVICE_ID_JOYPAD_UP,     SDL_SCANCODE_UP },
	{ RETRO_DEVICE_ID_JOYPAD_DOWN,   SDL_SCANCODE_DOWN },
	{ RETRO_DEVICE_ID_JOYPAD_LEFT,   SDL_SCANCODE_LEFT },
	{ RETRO_DEVICE_ID_JOYPAD_RIGHT,  SDL_SCANCODE_RIGHT },
	{ RETRO_DEVICE_ID_JOYPAD_A,      SDL_SCANCODE_LCTRL },   /* fire */
	{ RETRO_DEVICE_ID_JOYPAD_B,      SDL_SCANCODE_SPACE },   /* use/open */
	{ RETRO_DEVICE_ID_JOYPAD_X,      SDL_SCANCODE_RSHIFT },  /* run */
	{ RETRO_DEVICE_ID_JOYPAD_Y,      SDL_SCANCODE_TAB },     /* automap */
	{ RETRO_DEVICE_ID_JOYPAD_START,  SDL_SCANCODE_RETURN },  /* menu select */
	{ RETRO_DEVICE_ID_JOYPAD_SELECT, SDL_SCANCODE_ESCAPE },  /* menu */
	{ RETRO_DEVICE_ID_JOYPAD_L,      SDL_SCANCODE_COMMA },   /* strafe left */
	{ RETRO_DEVICE_ID_JOYPAD_R,      SDL_SCANCODE_PERIOD },  /* strafe right */
};

const struct s2s_libretro_desc s2s_libretro_desc = {
	.name = "doom",
	.version = "pizza-m5",
	.width = 320,
	.height = 200,
	.fps = 35.0,
	.sample_rate = 0.0,
	.keymap = doom_keymap,
	.keymap_len = sizeof(doom_keymap) / sizeof(doom_keymap[0]),

	.needs_content = true,
	.need_fullpath = true,
	.valid_extensions = "wad",
	.content_arg = "-iwad",
};
```

## src/empty.c
```c
/* SPDX-License-Identifier: Apache-2.0
 *
 * Dummy firmware TU -- the product of this app is doom.llext.
 */
```
