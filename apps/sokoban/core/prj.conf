## CMakeLists.txt
```
# SPDX-License-Identifier: Apache-2.0
#
# PiZZa -- sokoban built as a loadable libretro core (sokoban.llext).
#
# Same game + shim composition as the app build, minus everything the
# frontend owns (present backend, shell, btinput, USB, Zephyr main):
# the sdl2shim-over-libretro glue supplies the retro_* ABI, present
# seam, input synthesis and audio pump; sok_retro_desc.c is the only
# core-specific policy. Build against the SAME board as the frontend,
# then `west build -t sokoban_core` produces sokoban.llext.

cmake_minimum_required(VERSION 3.20.0)
find_package(Zephyr REQUIRED HINTS $ENV{ZEPHYR_BASE})
project(pizza_sokoban_core LANGUAGES C CXX)

set(SOK_DIR ${CMAKE_CURRENT_SOURCE_DIR}/..)
set(SOK_GAME_DIR ${SOK_DIR}/game)

include(${SOK_DIR}/../lib/sdl2shim/sdl2shim.cmake)

# Asset pack, baked into the core's rodata exactly as in the app build.
set(SOK_PACK_BIN ${CMAKE_BINARY_DIR}/sokoban_assets.bin)
file(GLOB_RECURSE SOK_DATA_FILES ${SOK_GAME_DIR}/data/*)
add_custom_command(
  OUTPUT ${SOK_PACK_BIN}
  COMMAND ${Python3_EXECUTABLE} ${SOK_DIR}/tools/pack_assets.py
          ${SOK_GAME_DIR}/data ${SOK_PACK_BIN} --font "Font/ARCADE_N.TTF@8"
  DEPENDS ${SOK_DATA_FILES} ${SOK_DIR}/tools/pack_assets.py
  COMMENT "Packing sokoban assets (PNG -> PIMG, TMX -> S2TM, TTF -> S2SA)"
)
add_custom_target(sok_core_assets DEPENDS ${SOK_PACK_BIN})

set_source_files_properties(${SOK_DIR}/src/sok_pack.S PROPERTIES
  OBJECT_DEPENDS ${SOK_PACK_BIN}
  COMPILE_OPTIONS "-I${CMAKE_BINARY_DIR};-Wa,-I${CMAKE_BINARY_DIR}"
)

add_llext_target(sokoban_core
	OUTPUT  ${PROJECT_BINARY_DIR}/sokoban.llext
	SOURCES
	  ${SOK_GAME_DIR}/src/main.cpp
	  ${SOK_GAME_DIR}/src/App.cpp
	  ${SOK_GAME_DIR}/src/Game.cpp
	  ${SOK_GAME_DIR}/src/MapRender.cpp
	  ${SOK_GAME_DIR}/src/Renderer.cpp
	  ${SOK_GAME_DIR}/src/TileMap.cpp
	  ${SOK_GAME_DIR}/src/hp_assert.cpp
	  ${SOK_DIR}/src/shim_tmx.c
	  ${SOK_DIR}/src/sok_assets.c
	  ${SOK_DIR}/src/sok_pack.S
	  ${SDL2SHIM_CORE_SOURCES}
	  ${SDL2SHIM_SURFACE_SOURCES}
	  ${SDL2SHIM_RW_SOURCES}
	  ${SDL2SHIM_RENDER_SOURCES}
	  ${SDL2SHIM_TTF_ATLAS_SOURCES}
	  ${SDL2SHIM_IMAGE_PIMG_SOURCES}
	  ${SDL2SHIM_LIBRETRO_SOURCES}
	  ${SDL2SHIM_LIBRETRO_CXXRT}
	  src/sok_retro_desc.c
	  src/sok_core_stdio.c
)
add_dependencies(sokoban_core sok_core_assets)

llext_include_directories(sokoban_core
	${SDL2SHIM_INCLUDE_DIRS}
	${SDL2SHIM_DIR}/include/SDL2
	${SOK_DIR}/include
	${SOK_DIR}/src
)

# C++ TUs emit COMDAT groups (inline/template methods); ld -r keeps
# them as SHT_GROUP + AXG sections, which the llext loader rejects
# (-ENOTSUP). --force-group-allocation resolves the groups into plain
# sections at the partial link, exactly as a final link would.
llext_link_options(sokoban_core
	-Wl,--force-group-allocation
)

llext_compile_options(sokoban_core
	-D__PICOLIBC_ERRNO_FUNCTION=s2s_core_errno_ptr
	-Wno-unused-variable
	-Wno-unused-but-set-variable
	-Wno-unused-parameter
	-Wno-missing-field-initializers
	-Wno-format-truncation
	-Wno-double-promotion
	-Wno-missing-prototypes
)

target_sources(app PRIVATE src/empty.c)
```

## Kconfig
```
# SPDX-License-Identifier: Apache-2.0
#
# sokoban core build -- pulls the shim's Kconfig for the SDL2SHIM_*
# symbols the shim TUs compile against (log level, libretro app
# stack). The audio-backend choice is irrelevant here (the core links
# the libretro audio backend directly).

rsource "../../lib/sdl2shim/Kconfig"

source "Kconfig.zephyr"
```

## prj.conf
```kconfig
# SPDX-License-Identifier: Apache-2.0
#
# sokoban.llext core build. The zephyr.bin here is a discarded dummy;
# these options exist to give the llext TUs the same compile
# environment as the frontend image that will host them (TLS errno,
# FPU, C++17 per the aarch64 recipe -- needs -DTOOLCHAIN_HAS_GLIBCXX=ON
# on the west line).

CONFIG_LLEXT=y
CONFIG_LLEXT_TYPE_ELF_RELOCATABLE=y

# NO TLS in core builds: with TLS on, picolibc's errno and Zephyr's
# k_current_get() become TLS-variable IMPORTS (errno, z_tls_current)
# that runtime llext symbol lookup cannot resolve (the Arduino EDK
# solves that at build time with generated tls-syms; we simply avoid
# it). TLS off makes errno the exportable __errno() function.
CONFIG_THREAD_LOCAL_STORAGE=n

CONFIG_CPP=y
CONFIG_STD_CPP17=y
CONFIG_GLIBCXX_LIBCPP=y

CONFIG_FPU=y
```

## src/empty.c
```c
/* SPDX-License-Identifier: Apache-2.0
 *
 * Dummy firmware TU -- the product of this app is sokoban.llext.
 */
```

## src/sok_core_stdio.c
```c
/*
 * SPDX-License-Identifier: Apache-2.0
 *
 * Core-local fopen/fclose for the sokoban llext build.
 *
 * In the APP build, picolibc tinystdio funnels the game's fopen
 * through open(), which sok_assets.c serves from the embedded pack.
 * In the CORE build fopen would import from the FRONTEND's picolibc,
 * whose open() knows nothing about the pack baked into this llext --
 * so provide fopen/fclose here and resolve them at partial link.
 *
 * Game.cpp only ever uses fopen as a level-EXISTENCE probe
 * (fopen -> NULL-check -> fclose, game/src/Game.cpp:62-68), so a
 * dummy non-NULL handle is contractually sufficient. Anything that
 * ever fread()s would need the full fd layer instead -- fail loudly
 * if that day comes.
 */

#include <stdio.h>
#include <stddef.h>
#include <stdint.h>

#include "sdl2shim.h"

FILE *fopen(const char *path, const char *mode)
{
	size_t size;

	(void)mode;
	if (s2s_asset_find(path, &size) != NULL) {
		return (FILE *)(uintptr_t)0x500BE;
	}
	return NULL;
}

int fclose(FILE *f)
{
	(void)f;
	return 0;
}
```

## src/sok_retro_desc.c
```c
/*
 * SPDX-License-Identifier: Apache-2.0
 *
 * sokoban core descriptor for the sdl2shim-over-libretro glue.
 *
 * Retropad -> sokoban keys, mirroring the app's btinput policy
 * (sokoban_btinput.c): dpad moves, A/START continue, B undo, X starts
 * Original, Y starts Microban, L restarts, R pauses. Nothing maps to
 * ESC -- quit stays a frontend affair.
 */

#include <SDL2/SDL.h>
#include <libretro.h>

#include "sdl2shim_libretro.h"

static const struct s2s_libretro_keybind sok_keymap[] = {
	{ RETRO_DEVICE_ID_JOYPAD_UP,     SDL_SCANCODE_UP },
	{ RETRO_DEVICE_ID_JOYPAD_DOWN,   SDL_SCANCODE_DOWN },
	{ RETRO_DEVICE_ID_JOYPAD_LEFT,   SDL_SCANCODE_LEFT },
	{ RETRO_DEVICE_ID_JOYPAD_RIGHT,  SDL_SCANCODE_RIGHT },
	{ RETRO_DEVICE_ID_JOYPAD_A,      SDL_SCANCODE_SPACE },
	{ RETRO_DEVICE_ID_JOYPAD_START,  SDL_SCANCODE_SPACE },
	{ RETRO_DEVICE_ID_JOYPAD_B,      SDL_SCANCODE_U },
	{ RETRO_DEVICE_ID_JOYPAD_X,      SDL_SCANCODE_O },
	{ RETRO_DEVICE_ID_JOYPAD_Y,      SDL_SCANCODE_M },
	{ RETRO_DEVICE_ID_JOYPAD_L,      SDL_SCANCODE_R },
	{ RETRO_DEVICE_ID_JOYPAD_R,      SDL_SCANCODE_P },
};

const struct s2s_libretro_desc s2s_libretro_desc = {
	.name = "sokoban",
	.version = "pizza-m3",
	.width = 640,
	.height = 480,
	.fps = 60.0,
	.sample_rate = 0.0,
	.keymap = sok_keymap,
	.keymap_len = sizeof(sok_keymap) / sizeof(sok_keymap[0]),
};
```
